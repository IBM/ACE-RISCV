## confidential-vms/linux_vm/configurations/qemu_riscv64_virt_defconfig
```kconfig
BR2_TARGET_GENERIC_HOSTNAME="cvm"
BR2_TARGET_GENERIC_ISSUE="Welcome to Confidential VM!"
# Architecture
BR2_riscv=y
BR2_RISCV_64=y
BR2_RISCV_g=y
BR2_RISCV_ABI_LP64D=y
BR2_GCC_TARGET_ABI="lp64d"
#
BR2_TOOLCHAIN_EXTERNAL=y
BR2_TOOLCHAIN_EXTERNAL_PATH="$(RISCV)"
BR2_TOOLCHAIN_EXTERNAL_CUSTOM_PREFIX="$(ARCH)-unknown-linux-gnu"
BR2_TOOLCHAIN_EXTERNAL_GCC_12=y
BR2_TOOLCHAIN_EXTERNAL_HEADERS_5_10=y
BR2_TOOLCHAIN_EXTERNAL_CUSTOM_GLIBC=y
#BR2_TOOLCHAIN_EXTERNAL_INET_RPC=y
BR2_TOOLCHAIN_EXTERNAL_INET_RPC=n
BR2_TOOLCHAIN_EXTERNAL_CXX=y

# Shell
BR2_PACKAGE_BUSYBOX_SHOW_OTHERS=y
BR2_PACKAGE_BASH=y
BR2_SYSTEM_BIN_SH_BASH=y

# System
BR2_SYSTEM_DHCP="eth0"
BR2_TARGET_GENERIC_GETTY=y
BR2_TARGET_GENERIC_GETTY_PORT="ttyS0"
BR2_TARGET_GENERIC_ROOT_PASSWD="passwd"

# Filesystem 
BR2_TARGET_ROOTFS_EXT2=y
BR2_ROOTFS_OVERLAY=""
BR2_TARGET_ROOTFS_EXT2_2=n
BR2_TARGET_ROOTFS_EXT2_3=n
BR2_TARGET_ROOTFS_EXT2_4=y
BR2_TARGET_ROOTFS_EXT2_SIZE="5G"

# Kernel
BR2_LINUX_KERNEL=y
BR2_LINUX_KERNEL_CUSTOM_VERSION=y
BR2_LINUX_KERNEL_CUSTOM_VERSION_VALUE="6.3-rc4"
BR2_PACKAGE_HOST_LINUX_HEADERS_CUSTOM_6_3=y
# BR2_LINUX_KERNEL_USE_ARCH_DEFAULT_CONFIG=y
BR2_LINUX_KERNEL_USE_CUSTOM_CONFIG=y
BR2_LINUX_KERNEL_CUSTOM_CONFIG_FILE=""
BR2_LINUX_KERNEL_IMAGE=y
BR2_LINUX_KERNEL_VMLINUX=y
BR2_LINUX_KERNEL_BZIMAGE=y
# specify patches of the linux kernel
BR2_LINUX_KERNEL_PATCH=""
# development with custom Linux kernel sources
BR2_PACKAGE_OVERRIDE_FILE=""

# Bootloader
# BR2_TARGET_OPENSBI=y
# BR2_TARGET_OPENSBI_USE_PLAT=y
# BR2_TARGET_OPENSBI_PLAT="qemu/virt"

# Packages
BR2_PACKAGE_DROPBEAR=y

BR2_TARGET_OPENSBI=y
BR2_TARGET_OPENSBI_PLAT="generic"

###
# BR2_TOOLCHAIN_BUILDROOT_GLIBC=y
# BR2_TOOLCHAIN_BUILDROOT_CXX=y
# BR2_PACKAGE_HOST_GDB=y
# BR2_PACKAGE_HOST_GDB_TUI=y
# BR2_PACKAGE_HOST_GDB_PYTHON3=y
# BR2_CCACHE=y
# BR2_CCACHE_INITIAL_SETUP="-M0 -F0"
# BR2_SSP_NONE=y

BR2_PER_PACKAGE_DIRECTORIES=y
BR2_VERBOSE=0
```

## hypervisor/configurations/qemu_riscv64_virt_defconfig
```kconfig
# Architecture
BR2_riscv=y
BR2_RISCV_64=y
BR2_RISCV_g=y
BR2_RISCV_ABI_LP64D=y
BR2_GCC_TARGET_ABI="lp64d"
#
BR2_TOOLCHAIN_EXTERNAL=y
BR2_TOOLCHAIN_EXTERNAL_PATH="$(RISCV)"
BR2_TOOLCHAIN_EXTERNAL_CUSTOM_PREFIX="$(ARCH)-unknown-linux-gnu"
BR2_TOOLCHAIN_EXTERNAL_GCC_12=y
BR2_TOOLCHAIN_EXTERNAL_HEADERS_5_10=y
BR2_TOOLCHAIN_EXTERNAL_CUSTOM_GLIBC=y
#BR2_TOOLCHAIN_EXTERNAL_INET_RPC=y
BR2_TOOLCHAIN_EXTERNAL_INET_RPC=n
BR2_TOOLCHAIN_EXTERNAL_CXX=y

# Shell
BR2_PACKAGE_BUSYBOX_SHOW_OTHERS=y
BR2_PACKAGE_BASH=y
BR2_SYSTEM_BIN_SH_BASH=y

# System
BR2_SYSTEM_DHCP="eth0"
#BR2_TARGET_GENERIC_GETTY=y
#BR2_TARGET_GENERIC_GETTY_PORT="ttyS0"
BR2_TARGET_GENERIC_ROOT_PASSWD="passwd"

# Filesystem
BR2_TARGET_ROOTFS_EXT2=y
BR2_ROOTFS_OVERLAY=""
BR2_TARGET_ROOTFS_EXT2_2=n
BR2_TARGET_ROOTFS_EXT2_3=n
BR2_TARGET_ROOTFS_EXT2_4=y
BR2_TARGET_ROOTFS_EXT2_SIZE="5G"

# Kernel
BR2_LINUX_KERNEL=y
BR2_LINUX_KERNEL_CUSTOM_VERSION=y
BR2_LINUX_KERNEL_CUSTOM_VERSION_VALUE="6.3-rc5"
BR2_PACKAGE_HOST_LINUX_HEADERS_CUSTOM_6_3=y
# BR2_LINUX_KERNEL_USE_ARCH_DEFAULT_CONFIG=y
BR2_LINUX_KERNEL_USE_CUSTOM_CONFIG=y
BR2_LINUX_KERNEL_CUSTOM_CONFIG_FILE=""
BR2_LINUX_KERNEL_IMAGE=y
BR2_LINUX_KERNEL_VMLINUX=y
BR2_LINUX_KERNEL_BZIMAGE=y
# specify patches of the linux kernel
BR2_LINUX_KERNEL_PATCH=""
# development with custom Linux kernel sources
BR2_PACKAGE_OVERRIDE_FILE=""

# Packages
BR2_PACKAGE_DROPBEAR=y

# Qemu
BR2_PACKAGE_QEMU=y
BR2_PACKAGE_QEMU_SLIRP=y
BR2_PACKAGE_QEMU_SYSTEM=y
# build just QEMU for riscv64
BR2_PACKAGE_QEMU_CHOOSE_TARGETS=y
BR2_PACKAGE_QEMU_TARGET_RISCV64=y
#
BR2_PACKAGE_QEMU_HAS_EMULS=y
BR2_PACKAGE_QEMU_FDT=y
BR2_PACKAGE_QEMU_TOOLS=y
BR2_PACKAGE_HOST_QEMU=y
BR2_PACKAGE_HOST_QEMU_SYSTEM_MODE=y
BR2_PACKAGE_QEMU_BLOBS=y

# below not needed?
BR2_TARGET_OPENSBI=y
BR2_TARGET_OPENSBI_PLAT="generic"

#BR2_PACKAGE_DEVMEM2=y

###
# BR2_TOOLCHAIN_BUILDROOT_GLIBC=y
# BR2_TOOLCHAIN_BUILDROOT_CXX=y
# BR2_PACKAGE_HOST_GDB=y
# BR2_PACKAGE_HOST_GDB_TUI=y
# BR2_PACKAGE_HOST_GDB_PYTHON3=y
# BR2_CCACHE=y
# BR2_CCACHE_INITIAL_SETUP="-M0 -F0"
# BR2_SSP_NONE=y

BR2_PER_PACKAGE_DIRECTORIES=y
BR2_VERBOSE=0
```

## security-monitor/platform/generic/Kconfig
```kconfig
# SPDX-License-Identifier: BSD-2-Clause

config PLATFORM_GENERIC
	bool
	select FDT
	select FDT_DOMAIN
	select FDT_PMU
	default y

if PLATFORM_GENERIC

config PLATFORM_GENERIC_NAME
	string "Platform default name"
	default "Generic"

config PLATFORM_GENERIC_MAJOR_VER
	int "Platform major version"
	range 0 65535
	default 0

config PLATFORM_GENERIC_MINOR_VER
	int "Platform minor version"
	range 0 65535
	default 1

endif
```

## security-monitor/platform/generic/configs/defconfig
```kconfig
//CONFIG_FDT_GPIO=y
//CONFIG_FDT_I2C=y
CONFIG_FDT_IPI=y
//CONFIG_FDT_IRQCHIP=y
//CONFIG_FDT_IRQCHIP_APLIC=y
CONFIG_FDT_IRQCHIP_PLIC=y
//CONFIG_FDT_REGMAP=y
//CONFIG_FDT_REGMAP_SYSCON=y
CONFIG_FDT_RESET=y
//CONFIG_FDT_RESET_GPIO=y
//CONFIG_FDT_RESET_SYSCON=y
CONFIG_FDT_SERIAL=y
CONFIG_FDT_SERIAL_UART8250=y
CONFIG_FDT_TIMER=y
CONFIG_FDT_TIMER_MTIMER=y
//CONFIG_FDT_TIMER_PLMT=y
```
